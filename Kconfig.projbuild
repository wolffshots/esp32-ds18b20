## Kconfig.projbuild
```kconfig
# https://www.kernel.org/doc/html/latest/kbuild/kconfig-language.html
menu "wolffshots/esp32-ds18b20 config"
    config TEMP_OWB_GPIO
        int "gpio pin for temp sensor"
        default 14
        help
            set to the pin that is connected to the data lead of the temp sensor
    config TEMP_MAX_DEVS
        int "max devices for owb"
        default 2
        help
            max number of devices to be connected to a onewire bus
    config TEMP_WRAPPER_TAG
        string "temp wrapper tag"
        default "esp32-ds18b20_wrapper"
        help
            tag for use with esp log library for wrapper
    config TEMP_TAG
        string "temp tag"
        default "esp32-ds18b20"
        help
            tag for use with esp log library for base
    config TEMP_SAMPLE_PERIOD
        int "sample period"
        default 1000
        help
            the sample period for the temp sensor to report in (in milliseconds))
endmenu
```
